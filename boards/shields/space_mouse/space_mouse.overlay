/ {
    chosen {
        zmk,kscan = &default_kscan;
    };

    default_kscan: kscan {
        compatible = "zmk,kscan-gpio-direct";
        label = "default_kscan";

        input-gpios =
            <zmk_btn0 (GPIO_ACTIVE_HIGH | GPIO_PULL_UP)>,
            <zmk_btn1 (GPIO_ACTIVE_HIGH | GPIO_PULL_UP)>,
            <zmk_btn2 (GPIO_ACTIVE_HIGH | GPIO_PULL_UP)>,
            <zmk_btn3 (GPIO_ACTIVE_HIGH | GPIO_PULL_UP)>;
    };
};